## CMakeLists.txt
```
cmake_minimum_required(VERSION 3.20.0)

find_package(Zephyr REQUIRED HINTS $ENV{ZEPHYR_BASE})

project(ble_txpower)

target_sources(app PRIVATE
    src/main.c
    src/ble.c
)

target_include_directories(app PRIVATE
    src/
)
```

## Kconfig
```
# Application Kconfig

mainmenu "BLE Demo LP"

config APP_ADV_INTERVAL_MS
	int "Advertising interval in milliseconds"
	default 2400
	range 20 10240
	help
	  BLE advertising interval in milliseconds.
	  Valid range is 20ms to 10240ms.

config APP_ADV_DURATION_MS
	int "Advertising duration in milliseconds"
	default 15000
	help
	  How long the device advertises before sleeping.

config APP_SLEEP_DURATION_MS
	int "Sleep duration in milliseconds"
	default 5000
	help
	  How long the device sleeps between advertising windows.

config APP_TX_POWER_DBM
	int "TX power level in dBm"
	default 0
	help
	  BLE TX power level in dBm.
	  Valid values: 3, 0, -4, -8, -12, -16, -20

source "Kconfig.zephyr"
```

## west.yml
```
manifest:
  remotes:
    - name: ncs
      url-base: https://github.com/nrfconnect
    - name: u-blox
      url-base: https://github.com/u-blox

  projects:
    - name: sdk-nrf
      remote: ncs
      revision: v3.3.0
      import: true

    # u-blox OpenCPU repo — provides ubx_evknorab2 BSP for NORA-B206
    # Required ONLY for the NORA-B206 build target.
    # The BL54L15 DVK and nRF54L15DK targets are already in NCS/Zephyr.
    - name: u-blox-sho-OpenCPU
      remote: u-blox
      repo-path: u-blox-sho-OpenCPU
      revision: main
      path: u-blox-sho-OpenCPU

  self:
    path: ble_txpower_multiboard
```

## prj.conf
```kconfig
# -------------------------------------------------------
# Low Power project config - NCS 3.3.0 / Zephyr 3.7
# ble_demo_lp - optimized for nRF54L15 power efficiency
# -------------------------------------------------------

# Bluetooth
CONFIG_BT=y
CONFIG_BT_PERIPHERAL=y
CONFIG_BT_DEVICE_NAME="TxPower_Beacon"
CONFIG_BT_MAX_CONN=1

# HCI Vendor-Specific extensions
CONFIG_BT_HCI_VS=y

# Disable unused BT features
CONFIG_BT_SMP=n
CONFIG_BT_GATT_CLIENT=n
CONFIG_BT_GATT_DYNAMIC_DB=n

# Console / logging — RTT instead of UART to save power
CONFIG_PRINTK=y
CONFIG_USE_SEGGER_RTT=y
CONFIG_RTT_CONSOLE=y
CONFIG_SERIAL=n
CONFIG_UART_CONSOLE=n

# Reduced heap and stack
CONFIG_HEAP_MEM_POOL_SIZE=4096
CONFIG_SYSTEM_WORKQUEUE_STACK_SIZE=1024

# nRF54L15: GRTC system timer
CONFIG_NRF_GRTC_TIMER=y
CONFIG_NRF_GRTC_START_SYSCOUNTER=y

# -------------------------------------------------------
# Customer Timing Configuration
# -------------------------------------------------------

# Advertising interval in milliseconds (default: 2400ms = 2.4 seconds)
# Valid range: 20ms - 10240ms
CONFIG_APP_ADV_INTERVAL_MS=2000

# Advertising duration in milliseconds (default: 15000ms = 15 seconds)
CONFIG_APP_ADV_DURATION_MS=10000

# Sleep duration in milliseconds (default: 5000ms = 5 seconds)
CONFIG_APP_SLEEP_DURATION_MS=15000

# TX Power level in dBm (default: 0 dBm)
# Valid values: 3, 0, -4, -8, -12, -16, -20
CONFIG_APP_TX_POWER_DBM=0
```

## boards/bl54l15_dvk_nrf54l15_cpuapp.overlay
```dts
/*
 * Board overlay: Ezurio BL54L15 DVK
 * Target: bl54l15_dvk/nrf54l15/cpuapp
 */

&uart20 {
    status = "okay";
    current-speed = <115200>;
};

/ {
    chosen {
        zephyr,console    = &uart20;
        zephyr,shell-uart = &uart20;
    };
};
```

## boards/nrf54l15dk_nrf54l15_cpuapp.overlay
```dts
/*
 * Board overlay: Nordic nRF54L15DK
 * Target: nrf54l15dk/nrf54l15/cpuapp
 *
 * UART20 is connected to the onboard J-Link CDC VCOM port (USB J3).
 * Default pins: TX=P1.04, RX=P1.05
 */

&uart20 {
    status = "okay";
    current-speed = <115200>;
};

/ {
    chosen {
        zephyr,console    = &uart20;
        zephyr,shell-uart = &uart20;
    };
};
```

## boards/ubx_evknorab2_nrf54l15_cpuapp.overlay
```dts
/*
 * Board overlay: u-blox EVK-NORA-B2 (NORA-B206)
 * Target: ubx_evknorab2/nrf54l15/cpuapp
 *
 * IMPORTANT - LFXO note:
 * The NORA-B206 module does NOT include an external 32.768 kHz crystal
 * on the module itself. The EVK board does fit an LFXO, but standalone
 * NORA-B206 modules default to LFRC.
 */

&uart20 {
    status = "okay";
    current-speed = <115200>;
};

/ {
    chosen {
        zephyr,console    = &uart20;
        zephyr,shell-uart = &uart20;
    };
};
```

## src/main.c
```c
/* main.c - Application main entry point */

/*
 * Copyright (c) 2019 Andrei Stoica
 *
 * SPDX-License-Identifier: Apache-2.0
 */

#include <zephyr/kernel.h>
#include <zephyr/sys/printk.h>
#include <zephyr/types.h>
#include <stddef.h>

#include "ble.h"

int main(void)
{
	BLE_Init();

	while (true) {
		printk("Advertising for %d ms at %d ms intervals...\n",
		       CONFIG_APP_ADV_DURATION_MS,
		       CONFIG_APP_ADV_INTERVAL_MS);
		BLE_AdvertisingStart();
		k_sleep(K_MSEC(CONFIG_APP_ADV_DURATION_MS));

		BLE_AdvertisingStop();
		printk("Sleeping for %d ms...\n", CONFIG_APP_SLEEP_DURATION_MS);
		k_sleep(K_MSEC(CONFIG_APP_SLEEP_DURATION_MS));
	}

	return 0;
}
```

## src/ble.c
```c
#include <zephyr/sys/printk.h>
#include <zephyr/sys/util.h>
#include <zephyr/sys/byteorder.h>

#include <zephyr/bluetooth/gap.h>
#include <zephyr/bluetooth/bluetooth.h>
#include <zephyr/bluetooth/hci.h>
#include <zephyr/bluetooth/hci_vs.h>

#include <zephyr/bluetooth/conn.h>
#include <zephyr/bluetooth/uuid.h>
#include <zephyr/bluetooth/gatt.h>

#include "ble.h"

/* NCS 3.3.0 / Zephyr 3.7+: BT_HCI_VS_EXT was merged into BT_HCI_VS. */
BUILD_ASSERT(IS_ENABLED(CONFIG_BT_HCI_VS),
	     "This app requires Zephyr-specific HCI vendor extensions");

static struct bt_conn *default_conn;
static uint16_t default_conn_handle;

/* Advertising data — name moved into ad[] to eliminate scan response radio exchange */
static const struct bt_data ad[] = {
	BT_DATA_BYTES(BT_DATA_FLAGS, (BT_LE_AD_GENERAL | BT_LE_AD_NO_BREDR)),
	BT_DATA_BYTES(BT_DATA_UUID16_ALL, BT_UUID_16_ENCODE(BT_UUID_HRS_VAL)),
	BT_DATA(BT_DATA_NAME_COMPLETE, CONFIG_BT_DEVICE_NAME,
		sizeof(CONFIG_BT_DEVICE_NAME) - 1),
};

#define DEVICE_NAME     CONFIG_BT_DEVICE_NAME
#define DEVICE_NAME_LEN (sizeof(DEVICE_NAME) - 1)

/* 2400ms advertising interval — conservative, saves radio-on time.
 * Non-connectable (BT_LE_ADV_OPT_NONE) — no scan window listening between events.
 * If connections are required, change to BT_LE_ADV_OPT_CONN. */
/* Interval set via CONFIG_APP_ADV_INTERVAL_MS in prj.conf */
#define ADV_INTERVAL_MS  (CONFIG_APP_ADV_INTERVAL_MS * 8 / 5)  /* 2400ms in units of 0.625ms */

static const struct bt_le_adv_param *param = BT_LE_ADV_PARAM(
	BT_LE_ADV_OPT_NONE,
	ADV_INTERVAL_MS,
	ADV_INTERVAL_MS,
	NULL);

/* TX power level used for both advertising and connections */
/* TX power set via CONFIG_APP_TX_POWER_DBM in prj.conf */
#define APP_TX_POWER_DBM  (CONFIG_APP_TX_POWER_DBM)

static void set_tx_power(uint8_t handle_type, uint16_t handle, int8_t tx_pwr_lvl)
{
	struct bt_hci_cp_vs_write_tx_power_level *cp;
	struct bt_hci_rp_vs_write_tx_power_level *rp;
	struct net_buf *buf, *rsp = NULL;
	int err;

	buf = bt_hci_cmd_alloc(K_FOREVER);
	if (!buf) {
		printk("Unable to allocate command buffer\n");
		return;
	}

	cp = net_buf_add(buf, sizeof(*cp));
	cp->handle = sys_cpu_to_le16(handle);
	cp->handle_type = handle_type;
	cp->tx_power_level = tx_pwr_lvl;

	err = bt_hci_cmd_send_sync(BT_HCI_OP_VS_WRITE_TX_POWER_LEVEL, buf, &rsp);
	if (err) {
		printk("Set Tx power err: %d\n", err);
		return;
	}

	rp = (void *)rsp->data;
	printk("Actual Tx Power: %d dBm\n", rp->selected_tx_power);

	net_buf_unref(rsp);
}

static void get_tx_power(uint8_t handle_type, uint16_t handle, int8_t *tx_pwr_lvl)
{
	struct bt_hci_cp_vs_read_tx_power_level *cp;
	struct bt_hci_rp_vs_read_tx_power_level *rp;
	struct net_buf *buf, *rsp = NULL;
	int err;

	*tx_pwr_lvl = 0xFF;
	buf = bt_hci_cmd_alloc(K_FOREVER);
	if (!buf) {
		printk("Unable to allocate command buffer\n");
		return;
	}

	cp = net_buf_add(buf, sizeof(*cp));
	cp->handle = sys_cpu_to_le16(handle);
	cp->handle_type = handle_type;

	err = bt_hci_cmd_send_sync(BT_HCI_OP_VS_READ_TX_POWER_LEVEL, buf, &rsp);
	if (err) {
		printk("Read Tx power err: %d\n", err);
		return;
	}

	rp = (void *)rsp->data;
	*tx_pwr_lvl = rp->tx_power_level;

	net_buf_unref(rsp);
}

static void connected(struct bt_conn *conn, uint8_t err)
{
	char addr[BT_ADDR_LE_STR_LEN];
	int8_t txp;
	int ret;

	if (err) {
		printk("Connection failed, err 0x%02x %s\n", err,
		       bt_hci_err_to_str(err));
	} else {
		default_conn = bt_conn_ref(conn);
		ret = bt_hci_get_conn_handle(default_conn, &default_conn_handle);
		if (ret) {
			printk("No connection handle (err %d)\n", ret);
		} else {
			bt_addr_le_to_str(bt_conn_get_dst(conn), addr,
					  sizeof(addr));
			printk("Connected via connection (%d) at %s\n",
			       default_conn_handle, addr);

			/* Set connection TX power to same level as advertising
			 * — avoids NO_PREF defaulting to max power */
			set_tx_power(BT_HCI_VS_LL_HANDLE_TYPE_CONN,
				     default_conn_handle, APP_TX_POWER_DBM);
			get_tx_power(BT_HCI_VS_LL_HANDLE_TYPE_CONN,
				     default_conn_handle, &txp);
			printk("Connection (%d) - Tx Power = %d dBm\n",
			       default_conn_handle, txp);
		}
	}
}

static void disconnected(struct bt_conn *conn, uint8_t reason)
{
	printk("Disconnected, reason 0x%02x %s\n", reason,
	       bt_hci_err_to_str(reason));

	if (default_conn) {
		bt_conn_unref(default_conn);
		default_conn = NULL;
	}
}

BT_CONN_CB_DEFINE(conn_callbacks) = {
	.connected = connected,
	.disconnected = disconnected,
};

static void bt_ready(int err)
{
	if (err) {
		printk("Bluetooth init failed (err %d)\n", err);
		return;
	}
	printk("Bluetooth initialized\n");
}

void BLE_Init(void)
{
	int err;
	int8_t tx_pwr_lvl_av = 0;

	default_conn = NULL;
	printk("Starting Dynamic Tx Power Beacon Demo (Low Power)\n");

	err = bt_enable(bt_ready);
	if (err) {
		printk("Bluetooth init failed (err %d)\n", err);
		return;
	}

	/* Set advertising TX power */
	set_tx_power(BT_HCI_VS_LL_HANDLE_TYPE_ADV, 0, APP_TX_POWER_DBM);
	get_tx_power(BT_HCI_VS_LL_HANDLE_TYPE_ADV, 0, &tx_pwr_lvl_av);
	printk("Advertising Tx Power set to %d dBm\n", tx_pwr_lvl_av);
}

void BLE_AdvertisingStart(void)
{
	int err;

	err = bt_le_adv_start(param, ad, ARRAY_SIZE(ad), NULL, 0);
	if (err) {
		printk("Advertising failed to start (err %d)\n", err);
		return;
	}
	printk("Advertising started\n");
}

void BLE_AdvertisingStop(void)
{
	bt_le_adv_stop();
	printk("Advertising stopped\n");
}
```

## src/ble.h
```c
#ifndef __BLE_H__
#define __BLE_H__

#include <zephyr/types.h>
#include <stddef.h>

void BLE_Init(void);
void BLE_AdvertisingStart(void);
void BLE_AdvertisingStop(void);

#endif
```
