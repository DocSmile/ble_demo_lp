## build_ezurio/Kconfig/boards/Kconfig.defconfig.tmp
```kconfig
# Load Zephyr board defconfig descriptions.
osource "/opt/nordic/ncs/v3.3.0/zephyr/boards/ezurio/bl54l15_dvk/Kconfig.defconfig"
```

## build_ublox/Kconfig/boards/Kconfig.sysbuild
```kconfig
# Load Sysbuild board Kconfig descriptions.
osource "/opt/nordic/ncs/v3.3.0/zephyr/boards/u-blox/ubx_evknorab2/Kconfig.sysbuild"
```

## build_ublox/Kconfig/boards/Kconfig.ubx_evknorab2
```kconfig
# Load board Kconfig descriptions.
osource "/opt/nordic/ncs/v3.3.0/zephyr/boards/u-blox/ubx_evknorab2/Kconfig.ubx_evknorab2"
```
